/* 
 * Copyright (c) 2023 The ZMK Contributors 
 * 
 * SPDX-License-Identifier: MIT 
 */ 

#include "urchin.dtsi" 


&kscan0 {
    diode-direction = "col2row";
    col-gpios
        = <&pro_micro 18 (GPIO_ACTIVE_HIGH)> // COL0
    ;
    row-gpios
        = <&pro_micro 6 (GPIO_ACTIVE_HIGH | GPIO_PULL_DOWN)> // ROW0
    ;
};
