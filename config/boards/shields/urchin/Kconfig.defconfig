## config/boards/shields/urchin/Kconfig.defconfig
```kconfig
# Copyright (c) 2022 Duccio Breschi
# SPDX-License-Identifier: MIT

if SHIELD_URCHIN_DONGLE
config ZMK_KEYBOARD_NAME
    default "urchin w. dongle"
endif

if SHIELD_URCHIN_DONGLE || SHIELD_URCHIN_LEFT || SHIELD_URCHIN_RIGHT
config ZMK_SPLIT
    default y
endif   
```
